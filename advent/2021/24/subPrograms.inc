switch (subprogram) {
case 0: {
w = inp[0];
x *= 0;
x += z;
x %= 26;
z /= 1;
x += 13;
x = x == w;
x = x == 0;
y *= 0;
y += 25;
y *= x;
y += 1;
z *= y;
y *= 0;
y += w;
y += 8;
y *= x;
z += y;
}
break;
case 1: {
w = inp[0];
x *= 0;
x += z;
x %= 26;
z /= 1;
x += 12;
x = x == w;
x = x == 0;
y *= 0;
y += 25;
y *= x;
y += 1;
z *= y;
y *= 0;
y += w;
y += 16;
y *= x;
z += y;
}
break;
case 2: {
w = inp[0];
x *= 0;
x += z;
x %= 26;
z /= 1;
x += 10;
x = x == w;
x = x == 0;
y *= 0;
y += 25;
y *= x;
y += 1;
z *= y;
y *= 0;
y += w;
y += 4;
y *= x;
z += y;
}
break;
case 3: {
w = inp[0];
x *= 0;
x += z;
x %= 26;
z /= 26;
x += -11;
x = x == w;
x = x == 0;
y *= 0;
y += 25;
y *= x;
y += 1;
z *= y;
y *= 0;
y += w;
y += 1;
y *= x;
z += y;
}
break;
case 4: {
w = inp[0];
x *= 0;
x += z;
x %= 26;
z /= 1;
x += 14;
x = x == w;
x = x == 0;
y *= 0;
y += 25;
y *= x;
y += 1;
z *= y;
y *= 0;
y += w;
y += 13;
y *= x;
z += y;
}
break;
case 5: {
w = inp[0];
x *= 0;
x += z;
x %= 26;
z /= 1;
x += 13;
x = x == w;
x = x == 0;
y *= 0;
y += 25;
y *= x;
y += 1;
z *= y;
y *= 0;
y += w;
y += 5;
y *= x;
z += y;
}
break;
case 6: {
w = inp[0];
x *= 0;
x += z;
x %= 26;
z /= 1;
x += 12;
x = x == w;
x = x == 0;
y *= 0;
y += 25;
y *= x;
y += 1;
z *= y;
y *= 0;
y += w;
y += 0;
y *= x;
z += y;
}
break;
case 7: {
w = inp[0];
x *= 0;
x += z;
x %= 26;
z /= 26;
x += -5;
x = x == w;
x = x == 0;
y *= 0;
y += 25;
y *= x;
y += 1;
z *= y;
y *= 0;
y += w;
y += 10;
y *= x;
z += y;
}
break;
case 8: {
w = inp[0];
x *= 0;
x += z;
x %= 26;
z /= 1;
x += 10;
x = x == w;
x = x == 0;
y *= 0;
y += 25;
y *= x;
y += 1;
z *= y;
y *= 0;
y += w;
y += 7;
y *= x;
z += y;
}
break;
case 9: {
w = inp[0];
x *= 0;
x += z;
x %= 26;
z /= 26;
x += 0;
x = x == w;
x = x == 0;
y *= 0;
y += 25;
y *= x;
y += 1;
z *= y;
y *= 0;
y += w;
y += 2;
y *= x;
z += y;
}
break;
case 10: {
w = inp[0];
x *= 0;
x += z;
x %= 26;
z /= 26;
x += -11;
x = x == w;
x = x == 0;
y *= 0;
y += 25;
y *= x;
y += 1;
z *= y;
y *= 0;
y += w;
y += 13;
y *= x;
z += y;
}
break;
case 11: {
w = inp[0];
x *= 0;
x += z;
x %= 26;
z /= 26;
x += -13;
x = x == w;
x = x == 0;
y *= 0;
y += 25;
y *= x;
y += 1;
z *= y;
y *= 0;
y += w;
y += 15;
y *= x;
z += y;
}
break;
case 12: {
w = inp[0];
x *= 0;
x += z;
x %= 26;
z /= 26;
x += -13;
x = x == w;
x = x == 0;
y *= 0;
y += 25;
y *= x;
y += 1;
z *= y;
y *= 0;
y += w;
y += 14;
y *= x;
z += y;
}
break;
case 13: {
w = inp[0];
x *= 0;
x += z;
x %= 26;
z /= 26;
x += -11;
x = x == w;
x = x == 0;
y *= 0;
y += 25;
y *= x;
y += 1;
z *= y;
y *= 0;
y += w;
y += 9;
y *= x;
z += y;
}
break;
}
return z;
